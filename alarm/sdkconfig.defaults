## alarm/sdkconfig.defaults
```kconfig
CONFIG_IDF_TARGET="esp32s3"

# 16 MB flash + 8 MB octal PSRAM
CONFIG_ESPTOOLPY_FLASHSIZE_16MB=y
CONFIG_SPIRAM=y
CONFIG_SPIRAM_MODE_OCT=y
CONFIG_SPIRAM_SPEED_80M=y

# Smoother LVGL
CONFIG_FREERTOS_HZ=1000

# Fonts for the clock UI
CONFIG_LV_FONT_MONTSERRAT_28=y
CONFIG_LV_FONT_MONTSERRAT_48=y
CONFIG_LV_ASSERT_HANDLER_INCLUDE="assert.h"
```
